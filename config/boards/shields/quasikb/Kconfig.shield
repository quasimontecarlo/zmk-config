## config/boards/shields/quasikb/Kconfig.shield
```kconfig
# Copyright (c) 2020 Pete Johanson
# SPDX-License-Identifier: MIT

config SHIELD_QUASIKB_LEFT
    def_bool $(shields_list_contains,quasikb_left)

config SHIELD_QUASIKB_RIGHT
    def_bool $(shields_list_contains,quasikb_right)
```

## config/west.yml
```yaml
manifest:
  remotes:
    - name: zmkfirmware
      url-base: https://github.com/zmkfirmware
    - name: quasimontecarlo
      url-base: https://github.com/quasimontecarlo
  projects:
    - name: zmk
      remote: quasimontecarlo
      revision: main
      import: app/west.yml
    #- name: zmk
    #  remote: zmkfirmware
    #  revision: main
    #  import: app/west.yml
  self:
    path: config
```
