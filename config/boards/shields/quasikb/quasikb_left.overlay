/*
 * Copyright (c) 2020 Pete Johanson
 *
 * SPDX-License-Identifier: MIT
 */

#include "quasikb.dtsi"

&kscan0 {
    input-gpios
        = <&gpio1 1 (GPIO_ACTIVE_HIGH | GPIO_PULL_DOWN)>
        , <&gpio1 2 (GPIO_ACTIVE_HIGH | GPIO_PULL_DOWN)>
        , <&gpio1 7 (GPIO_ACTIVE_HIGH | GPIO_PULL_DOWN)>
        ;
};
